## conf/layer.conf
```bitbake
# We have a conf and classes directory, add to BBPATH
BBPATH := "${BBPATH}:${LAYERDIR}"

# We have a packages directory, add to BBFILES
BBFILES += "${LAYERDIR}/recipes*/*/*.bb ${LAYERDIR}/recipes*/*/*.bbappend"

BBFILE_COLLECTIONS += "leon"
BBFILE_PATTERN_leon := "^${LAYERDIR}/"
BBFILE_PRIORITY_leon = "6"
```

## conf/machine/include/sparc/arch-sparc.inc
```bitbake
# SPARC Architecture definition

DEFAULTTUNE ?= "sparc"

TUNE_PKGARCH = "${TUNE_PKGARCH_tune-${DEFAULTTUNE}}"

TUNEVALID[v7] = "Enable instructions for SPARC v7"

TUNEVALID[v8] = "Enable instructions for SPARC v8"
TUNECONFLICTS[v8] = "v7 sparclite sparclet v9"

TUNEVALID[sparclite] = "Enable instructions for SPARClite variant"
TUNECONFLICTS[sparclite] = "v7 v8 sparclet v9"

TUNEVALID[sparclet] = "Enable instructions for SPARClet variant"
TUNECONFLICTS[sparclet] = "v7 v8 sparclite v9"

TUNEVALID[v9] = "Enable instructions for SPARC v9"
TUNECONFLICTS[v9] = "v7 v8 sparclite sparclet"

TUNEVALID[m32] = "Sparc 32-bit environment"
TUNE_CCARGS .= "${@bb.utils.contains("TUNE_FEATURES", "m32", " -m32", "", d)}"
TUNE_ARCH .= "${@bb.utils.contains("TUNE_FEATURES", "m32", "sparc", "", d)}"

TUNEVALID[m64] = "Sparc 64-bit environment"
TUNE_CCARGS .= "${@bb.utils.contains("TUNE_FEATURES", "m64", " -m64", "", d)}"
TUNE_ARCH .= "${@bb.utils.contains("TUNE_FEATURES", "m64", "sparc", "", d)}"

TUNEVALID[fpu-hard] = "Use hardware FPU."
TUNE_CCARGS .= "${@bb.utils.contains("TUNE_FEATURES", "fpu-hard", " -mhard-float", "", d)}"

TUNEVALID[fpu-soft] = "Use software FPU."
TUNE_CCARGS .= "${@bb.utils.contains("TUNE_FEATURES", "fpu-soft", " -msoft-float", "", d)}"
TARGET_FPU .= "${@bb.utils.contains("TUNE_FEATURES", "fpu-soft", "soft", "", d)}"

# Basic tune definitions
AVAILTUNES += "sparc"

TUNE_FEATURES_tune-sparc = "v7 m32 fpu-hard"
BASE_LIB_tune-sparc = "lib"
TUNE_PKGARCH_tune-sparc = "sparc"
PACKAGE_EXTRA_ARCHS_tune-sparc = "sparc"
```

## conf/machine/include/tune-cypress.inc
```bitbake
DEFAULTTUNE ?= "cypress"

require conf/machine/include/sparc/arch-sparc.inc

TUNEVALID[cypress] = "Enable Cypress CY7C602 specific processor optimizations"
TUNE_CCARGS += "${@bb.utils.contains("TUNE_FEATURES", "cypress", "-mcpu=cypress", "", d)}"

AVAILTUNES += "cypress"

TUNE_FEATURES_tune-cypress = "v7 m32 cypress"
TUNE_PKGARCH_tune-cypress = "cypress"
PACKAGE_EXTRA_ARCHS_tune-cypress = "${PACKAGE_EXTRA_ARCHS_tune-sparc} cypress"
```

## conf/machine/include/tune-hypersparc.inc
```bitbake
DEFAULTTUNE ?= "hypersparc"

require conf/machine/include/sparc/arch-sparc.inc

TUNEVALID[hypersparc] = "Enable HyperSPARC specific processor optimizations"
TUNE_CCARGS += "${@bb.utils.contains("TUNE_FEATURES", "hypersparc", "-mcpu=hypersparc", "", d)}"

AVAILTUNES += "hypersparc"

TUNE_FEATURES_tune-hypersparc = "v8 m32 hypersparc"
TUNE_PKGARCH_tune-hypersparc = "hypersparc"
PACKAGE_EXTRA_ARCHS_tune-hypersparc = "${PACKAGE_EXTRA_ARCHS_tune-sparc} hypersparc"
```

## conf/machine/include/tune-leon.inc
```bitbake
DEFAULTTUNE ?= "leon3"

require conf/machine/include/sparc/arch-sparc.inc

TUNEVALID[leon2] = "Enable LEON2 specific processor optimizations"
TUNE_CCARGS += "${@bb.utils.contains("TUNE_FEATURES", "leon2", "-mcpu=leon", "", d)}"

TUNEVALID[leon3] = "Enable LEON3 specific processor optimizations"
TUNE_CCARGS += "${@bb.utils.contains("TUNE_FEATURES", "leon3", "-mcpu=leon", "", d)}"

AVAILTUNES += "leon2 leon3"

TUNE_FEATURES_tune-leon2 = "v8 m32 leon2"
TUNE_PKGARCH_tune-leon2 = "leon2"
PACKAGE_EXTRA_ARCHS_tune-leon2 = "${PACKAGE_EXTRA_ARCHS_tune-sparc} leon2"

TUNE_FEATURES_tune-leon3 = "v8 m32 leon3"
TUNE_PKGARCH_tune-leon3 = "leon3"
PACKAGE_EXTRA_ARCHS_tune-leon3 = "${PACKAGE_EXTRA_ARCHS_tune-sparc} leon3"
```

## conf/machine/include/tune-niagara.inc
```bitbake
DEFAULTTUNE ?= "niagara"

require conf/machine/include/sparc/arch-sparc.inc

TUNEVALID[niagara] = "Enable Sun UltraSPARC T1 specific processor optimizations"
TUNE_CCARGS += "${@bb.utils.contains("TUNE_FEATURES", "niagara", "-mcpu=niagara", "", d)}"

TUNEVALID[niagara2] = "Enable Sun UltraSPARC T2 specific processor optimizations"
TUNE_CCARGS += "${@bb.utils.contains("TUNE_FEATURES", "niagara2", "-mcpu=niagara2", "", d)}"

TUNEVALID[niagara3] = "Enable Sun UltraSPARC T3 specific processor optimizations"
TUNE_CCARGS += "${@bb.utils.contains("TUNE_FEATURES", "niagara3", "-mcpu=niagara3", "", d)}"

TUNEVALID[niagara4] = "Enable Sun UltraSPARC T4 specific processor optimizations"
TUNE_CCARGS += "${@bb.utils.contains("TUNE_FEATURES", "niagara4", "-mcpu=niagara4", "", d)}"

AVAILTUNES += "niagara niagara2 niagara3 niagara4"

TUNE_FEATURES_tune-niagara = "v9 m64 niagara"
TUNE_PKGARCH_tune-niagara = "niagara"
PACKAGE_EXTRA_ARCHS_tune-niagara = "${PACKAGE_EXTRA_ARCHS_tune-sparc} niagara"

TUNE_FEATURES_tune-niagara2 = "v9 m64 niagara2"
TUNE_PKGARCH_tune-niagara2 = "niagara2"
PACKAGE_EXTRA_ARCHS_tune-niagara2 = "${PACKAGE_EXTRA_ARCHS_tune-sparc} niagara2"

TUNE_FEATURES_tune-niagara3 = "v9 m64 niagara3"
TUNE_PKGARCH_tune-niagara3 = "niagara3"
PACKAGE_EXTRA_ARCHS_tune-niagara3 = "${PACKAGE_EXTRA_ARCHS_tune-sparc} niagara3"

TUNE_FEATURES_tune-niagara4 = "v9 m64 niagara4"
TUNE_PKGARCH_tune-niagara4 = "niagara4"
PACKAGE_EXTRA_ARCHS_tune-niagara4 = "${PACKAGE_EXTRA_ARCHS_tune-sparc} niagara4"
```

## conf/machine/include/tune-supersparc.inc
```bitbake
DEFAULTTUNE ?= "supersparc"

require conf/machine/include/sparc/arch-sparc.inc

TUNEVALID[supersparc] = "Enable SuperSparc specific processor optimizations"
TUNE_CCARGS += "${@bb.utils.contains("TUNE_FEATURES", "supersparc", "-mcpu=supersparc", "", d)}"

AVAILTUNES += "supersparc"

TUNE_FEATURES_tune-supersparc = "v8 m32 supersparc"
TUNE_PKGARCH_tune-supersparc = "supersparc"
PACKAGE_EXTRA_ARCHS_tune-supersparc = "${PACKAGE_EXTRA_ARCHS_tune-sparc} supersparc"
```

## conf/machine/include/tune-ultrasparc.inc
```bitbake
DEFAULTTUNE ?= "ultrasparc"

require conf/machine/include/sparc/arch-sparc.inc

TUNEVALID[ultrasparc] = "Enable UltraSPARC specific processor optimizations"
TUNE_CCARGS += "${@bb.utils.contains("TUNE_FEATURES", "ultrasparc", "-mcpu=ultrasparc", "", d)}"

TUNEVALID[ultrasparc3] = "Enable UltraSPARC III specific processor optimizations"
TUNE_CCARGS += "${@bb.utils.contains("TUNE_FEATURES", "ultrasparc3", "-mcpu=ultrasparc3", "", d)}"

AVAILTUNES += "ultrasparc ultrasparc3"

TUNE_FEATURES_tune-ultrasparc = "v9 m64 ultrasparc"
TUNE_PKGARCH_tune-ultrasparc = "ultrasparc"
PACKAGE_EXTRA_ARCHS_tune-ultrasparc = "${PACKAGE_EXTRA_ARCHS_tune-sparc} ultrasparc"

TUNE_FEATURES_tune-ultrasparc3 = "v9 m64 ultrasparc3"
TUNE_PKGARCH_tune-ultrasparc3 = "ultrasparc3"
PACKAGE_EXTRA_ARCHS_tune-ultrasparc3 = "${PACKAGE_EXTRA_ARCHS_tune-sparc} ultrasparc3"
```

## conf/machine/qemusparc.conf
```bitbake
#@TYPE: Machine
#@NAME: qemu SPARC Emulator setup
#@DESCRIPTION: Machine configuration for running a SPARC system under qemu emulation

require conf/machine/include/qemu.inc
require conf/machine/include/tune-leon.inc

KERNEL_IMAGETYPE = "vmlinux"

SERIAL_CONSOLE = "115200 ttyS0"
```
